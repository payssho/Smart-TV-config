## buildroot/Config.in
```kconfig
menu "Télé maison"

source "$BR2_EXTERNAL_TELE_PATH/package/tele-systeme/Config.in"
source "$BR2_EXTERNAL_TELE_PATH/package/tele-jumeau/Config.in"

endmenu
```

## buildroot/package/tele-jumeau/Config.in
```kconfig
config BR2_PACKAGE_TELE_JUMEAU
	bool "tele-jumeau (banc de test, pas pour la box)"
	depends on BR2_PACKAGE_TELE_SYSTEME
	depends on BR2_PACKAGE_FFMPEG_ARCH_SUPPORTS
	depends on BR2_USE_WCHAR # python3
	depends on BR2_TOOLCHAIN_HAS_THREADS # python3
	depends on !BR2_STATIC_LIBS # python3
	select BR2_PACKAGE_PYTHON3
	select BR2_PACKAGE_FFMPEG
	select BR2_PACKAGE_FFMPEG_FFMPEG
	help
	  Scénario de test joué dans le jumeau QEMU de la box
	  (scripts/jumeau/, ADR 0019) : il se lance si la ligne de
	  commande du noyau contient tele.scenario=..., écrit son
	  rapport chez l'hôte puis éteint la machine.

	  Amène python3 et ffmpeg, qui ne servent qu'au banc : à ne
	  pas activer dans l'image de la vraie box.
```

## buildroot/package/tele-systeme/Config.in
```kconfig
config BR2_PACKAGE_TELE_SYSTEME
	bool "tele-systeme"
	depends on BR2_INIT_SYSTEMD
	depends on BR2_USE_MMU # util-linux
	select BR2_PACKAGE_UTIL_LINUX
	select BR2_PACKAGE_UTIL_LINUX_BINARIES # swapon -p, mkswap, fstrim, flock
	select BR2_PACKAGE_UTIL_LINUX_SCHEDUTILS # ionice, chrt
	help
	  Scripts système de la télé (dossier systeme/ du dépôt) :
	  tele-memoire (zram et réglages du noyau selon la RAM),
	  tele-role (rang de chaque brique face au manque de mémoire)
	  et tele-entretien (ménage au repos), avec leurs unités
	  systemd. Voir l'ADR 0020.

	  Les outils complets de util-linux sont installés : le
	  BusyBox de Buildroot n'a ni « swapon -p » ni « ionice ».

comment "tele-systeme demande systemd comme init"
	depends on !BR2_INIT_SYSTEMD
```
